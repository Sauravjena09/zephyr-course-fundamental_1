/dts-v1/;

#include <nxp/mcx/nxp_mcxn23x.dtsi>

/ {
    model = "Scratch MCXN236";
    compatible = "custom,scratch-mcxn236", "nxp,mcx";
       chosen {
		zephyr,sram = &sram0;
		zephyr,flash = &flash;
		zephyr,flash-controller = &fmu;
		// zephyr,code-partition = &slot0_partition;
		zephyr,uart-mcumgr = &flexcomm4_lpuart4;
		zephyr,console = &flexcomm4_lpuart4;
		zephyr,shell-uart = &flexcomm4_lpuart4;
		zephyr,canbus = &flexcan1;
		zephyr,edac = &erm0;
		zephyr,system-timer-companion = &lptmr0;
		zephyr,crc = &crc;
	    };
};
