## boards/custom/scratch_mcxn236/Kconfig
```kconfig
# Copyright 2025 NXP
# SPDX-License-Identifier: Apache-2.0

config BOARD_SCRATCH_MCXN236
	bool
```

## boards/custom/scratch_mcxn236/Kconfig.scratch_mcxn236
```kconfig
# Copyright 2025 NXP
# SPDX-License-Identifier: Apache-2.0

config BOARD_SCRATCH_MCXN236
	select SOC_MCXN236
	select SOC_PART_NUMBER_MCXN236VDF
```

## boards/custom/scratch_mcxn236/board.yml
```yaml
board:
  name: scratch_mcxn236
  full_name: Custom MCXN236 From Scratch
  vendor: custom
  socs:
  - name: mcxn236
```

## boards/custom/scratch_mcxn236/scratch_mcxn236_defconfig
```kconfig
#
# Copyright 2024 NXP
#
CONFIG_SOC_SERIES_MCXN=y
CONFIG_SOC_MCXN236=y
CONFIG_SOC_PART_NUMBER_MCXN236VDF=y

CONFIG_CORTEX_M_SYSTICK=y
CONFIG_SYS_CLOCK_HW_CYCLES_PER_SEC=150000000
CONFIG_SYS_CLOCK_TICKS_PER_SEC=1000

CONFIG_SERIAL=y
CONFIG_CONSOLE=y
CONFIG_UART_CONSOLE=y
```

## led_sensor_module/drivers/sensor/led_sensor/Kconfig
```kconfig
menuconfig CUSTOM_LED_SENSOR
    bool "Custom LED sensor driver"
    default y
    depends on DT_HAS_CUSTOM_LED_SENSOR_ENABLED
    select GPIO
    help 
        Enable the custom LED sensor driver.
        
```

## led_sensor_module/dts/bindings/sensor/custom,led-sensor.yaml
```yaml
description: Custom LED Sensor driver binding
compatible: "custom,led-sensor"

include: sensor-device.yaml

properties:
  led-gpios:
    type: phandle-array
    required: true
    description: GPIOS pin connected to the LED
```

## twister-out.2/qemu_x86_atom/zephyr_gnu/zephyr-course-A1-/tests/ring_buf/homework.unit.ring_buf/Kconfig/arch/Kconfig
```kconfig
# Load Zephyr Arch Kconfig descriptions.
osource "C:/Users/saura/zephyrproject/zephyr/arch/rx/Kconfig"
osource "C:/Users/saura/zephyrproject/zephyr/arch/x86/Kconfig"
osource "C:/Users/saura/zephyrproject/zephyr/arch/xtensa/Kconfig"
osource "C:/Users/saura/zephyrproject/zephyr/arch/sparc/Kconfig"
osource "C:/Users/saura/zephyrproject/zephyr/arch/riscv/Kconfig"
osource "C:/Users/saura/zephyrproject/zephyr/arch/posix/Kconfig"
osource "C:/Users/saura/zephyrproject/zephyr/arch/openrisc/Kconfig"
osource "C:/Users/saura/zephyrproject/zephyr/arch/mips/Kconfig"
osource "C:/Users/saura/zephyrproject/zephyr/arch/arm64/Kconfig"
osource "C:/Users/saura/zephyrproject/zephyr/arch/arm/Kconfig"
osource "C:/Users/saura/zephyrproject/zephyr/arch/arc/Kconfig"
```

## twister-out.2/qemu_x86_atom/zephyr_gnu/zephyr-course-A1-/tests/ring_buf/homework.unit.ring_buf/Kconfig/boards/Kconfig.defconfig
```kconfig
# Load Zephyr board defconfig descriptions.
osource "C:/Users/saura/zephyrproject/zephyr/boards/qemu/x86/Kconfig.defconfig"
```

## twister-out.2/qemu_x86_atom/zephyr_gnu/zephyr-course-A1-/tests/ring_buf/homework.unit.ring_buf/Kconfig/boards/Kconfig.qemu_x86
```kconfig
# Load board Kconfig descriptions.
osource "C:/Users/saura/zephyrproject/zephyr/boards/qemu/x86/Kconfig.qemu_x86"
```
