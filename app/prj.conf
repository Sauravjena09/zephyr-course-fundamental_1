## CMakeLists.txt
```
cmake_minimum_required(VERSION 3.20.0)

# Tell Zephyr where our custom out-of-tree module is located
# (Assumes led_sensor_module is up one directory from the app folder)
list(APPEND ZEPHYR_EXTRA_MODULES ${CMAKE_CURRENT_SOURCE_DIR}/../led_sensor_module)

find_package(Zephyr REQUIRED HINTS $ENV{ZEPHYR_BASE})
project(led_sensor_app)

target_sources(app PRIVATE src/main.cpp)
```

## Kconfig
```
source "Kconfig.zephyr"
menuconfig LED_SUBSYSTEM
    bool "LED Subsystem"
    default y

if LED_SUBSYSTEM

config APP_HEARTBEAT_PERIOD_MS
    int "Heartbeat LED period in milliseconds"
    default 500
    range 100 2000


menuconfig ADVANCED_LED_SETTINGS
    bool "Advanced LED settings"

if ADVANCED_LED_SETTINGS

config LED_BRIGHTNESS
    int "LED brightness (0-100)"
    range 0 100
    default 100

config LED_FADE_DURATION
    int "LED fade duration (ms)"
    range 0 5000
    default 500

menu "Expert settings"

config ENABLE_LED_DEBUGGING
    bool "Enable LED debugging"

config CUSTOM_BLINK_PATTERN
    bool "Custom blink pattern"

endmenu

endif
endif
```

## prj.conf
```kconfig
CONFIG_SENSOR_LOG_LEVEL_DBG=y
CONFIG_SENSOR=y
CONFIG_CUSTOM_LED_SENSOR=y
CONFIG_LOG=y
CONFIG_GPIO=y
CONFIG_SHELL=y
```

## app.overlay
```dts
/ {
    led_sensor_dev: led_sensor {
        compatible = "custom,led-sensor";
        led-gpios = <&gpioa 5 GPIO_ACTIVE_HIGH>;
        status = "okay";
    };
};
```

## src/main.cpp
```c
#include <zephyr/kernel.h>
#include <zephyr/device.h>
#include <zephyr/drivers/sensor.h>
#include <zephyr/logging/log.h>
#include <zephyr/shell/shell.h>
#include <stdlib.h>
#include "custom_drivers/led_sensor.h"

LOG_MODULE_REGISTER(main);

static int cmd_sensor_fetch(const struct shell *sh, size_t argc, char **argv) {
    const struct device *dev = DEVICE_DT_GET_ANY(custom_led_sensor);
    if (dev == NULL || !device_is_ready(dev)) {
        shell_error(sh, "Device not ready");
        return -ENODEV;
    }
    sensor_sample_fetch(dev);
    shell_print(sh, "sensor_sample_fetch() called");
    return 0;
}

static int cmd_sensor_read(const struct shell *sh, size_t argc, char **argv) {
    const struct device *dev = DEVICE_DT_GET_ANY(custom_led_sensor);
    if (dev == NULL || !device_is_ready(dev)) {
        shell_error(sh, "Device not ready");
        return -ENODEV;
    }
    struct sensor_value val;
    sensor_channel_get(dev, SENSOR_CHAN_ALL, &val);
    shell_print(sh, "sensor_channel_get() called. Result: val1=%d, val2=%d", val.val1, val.val2);
    return 0;
}

static int cmd_sensor_info(const struct shell *sh, size_t argc, char **argv) {
    const struct device *dev = DEVICE_DT_GET_ANY(custom_led_sensor);
    if (dev == NULL) {
        shell_error(sh, "No device found");
        return -ENODEV;
    }
    shell_print(sh, "Device name: %s", dev->name);
    shell_print(sh, "Ready state: %s", device_is_ready(dev) ? "true" : "false");
    return 0;
}

static int cmd_sensor_set(const struct shell *sh, size_t argc, char **argv) {
    const struct device *dev = DEVICE_DT_GET_ANY(custom_led_sensor);
    if (dev == NULL || !device_is_ready(dev)) {
        shell_error(sh, "Device not ready");
        return -ENODEV;
    }

    if (argc < 2) {
        shell_error(sh, "Missing argument");
        return -EINVAL;
    }

    long val = strtol(argv[1], NULL, 10);
    if (val < 0 || val > 100) {
        shell_error(sh, "Argument out of range (must be 0-100)");
        return -EINVAL;
    }

    int ret = led_sensor_set_custom_param(dev, (int)val);
    if (ret == 0) {
        shell_print(sh, "Custom param set to %d", (int)val);
    } else {
        shell_error(sh, "Failed to set custom param");
    }
    return 0;
}

SHELL_STATIC_SUBCMD_SET_CREATE(sub_sensor,
    SHELL_CMD(fetch, NULL, "calls sensor_sample_fetch()", cmd_sensor_fetch),
    SHELL_CMD(info, NULL, "prints the device name and ready state", cmd_sensor_info),
    SHELL_CMD(read, NULL, "calls sensor_channel_get() and prints the result", cmd_sensor_read),
    SHELL_CMD_ARG(set, NULL, "sets a custom value", cmd_sensor_set, 2, 0),
    SHELL_SUBCMD_SET_END
);

SHELL_CMD_REGISTER(sensor, &sub_sensor, "Sensor shell command", NULL);

int main(void)
{
    /* Fetch the device handle mapped to our compatible */
    const struct device *dev = DEVICE_DT_GET_ANY(custom_led_sensor);

    if (dev == NULL) {
        LOG_ERR("No device found with compatible 'custom,led-sensor'");
        return -ENODEV;
    }

    if (!device_is_ready(dev)) {
        LOG_ERR("Device %s is not ready", dev->name);
        return -ENODEV;
    }

    LOG_INF("Found ready device: %s", dev->name);
    LOG_INF("Shell is enabled. Try running 'sensor info', 'sensor fetch', 'sensor read', or 'sensor set <val>' over UART.");

    return 0;
}
```
